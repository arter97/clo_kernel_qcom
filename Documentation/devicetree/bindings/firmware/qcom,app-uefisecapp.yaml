## Documentation/devicetree/bindings/firmware/qcom,app-uefisecapp.yaml
```yaml
# SPDX-License-Identifier: (GPL-2.0-only OR BSD-2-Clause)
%YAML 1.2
---
$id: http://devicetree.org/schemas/firmware/qcom,app-uefisecapp.yaml#
$schema: http://devicetree.org/meta-schemas/core.yaml#

title: UEFISecApp client driver to provide access to EFI variables.

description:
   This facilitates communication with the uefisecapp Secure Application
   in QTEE firmware OS to provide access to EFI variables on platforms
   without EFI runtime support.

maintainers:
  - Harshal Dev <hdev@qti.qualcomm.com>

properties:
  compatible:
    const: qcom,app-uefisecapp

required:
  - compatible

additionalProperties: false

examples:
  - |
    firmware {
        qcom_app_uefisecapp {
            compatible = "qcom,app-uefisecapp";
        };
    };
```

## Documentation/devicetree/bindings/nvmem/layouts/qcom,sa8797p-eth-mac.yaml
```yaml
# SPDX-License-Identifier: (GPL-2.0-only OR BSD-2-Clause)
%YAML 1.2
---
$id: http://devicetree.org/schemas/nvmem/layouts/qcom,sa8797p-eth-mac.yaml#
$schema: http://devicetree.org/meta-schemas/core.yaml#

title: Qualcomm SA8797P Ethernet MAC address NVMEM layout

maintainers:
  - Hongmei Xu <hongmeix@qti.qualcomm.com>

description:
  Layout driver for reading Ethernet MAC addresses from Qualcomm eFuse
  (QFPROM). Supports cells where one or more output bytes are
  non-contiguous in eFuse via the qcom,byte-fixups property.

select: false

properties:
  compatible:
    const: qcom,sa8797p-eth-mac

patternProperties:
  "^eth[0-9]+-mac@[0-9a-f]+$":
    type: object
    description: Ethernet MAC address cell

    properties:
      reg:
        maxItems: 1

      qcom,byte-fixups:
        $ref: /schemas/types.yaml#/definitions/uint32-array
        description:
          Pairs of <byte_idx src_offset> for bytes that are stored
          at a non-contiguous eFuse offset. byte_idx is the zero-based
          index of the output byte to override, and src_offset is the
          absolute byte offset within the NVMEM device where the source
          byte resides. The number of elements must be a multiple of 2.
        minItems: 2
        maxItems: 12
        multipleOf: 2
    required:
      - reg

    additionalProperties: false

required:
  - compatible

additionalProperties: false

examples:
  - |
    efuse@360d4000 {
        compatible = "qcom,sa8797p-qfprom", "qcom,qfprom";
        reg = <0x360d4000 0x4000>;
        #address-cells = <1>;
        #size-cells = <1>;

        nvmem-layout {
            compatible = "qcom,sa8797p-eth-mac";
            #address-cells = <1>;
            #size-cells = <1>;

            eth1_mac: eth1-mac@320 {
                reg = <0x320 0x6>;
                qcom,byte-fixups = <5 0x326>;
            };
        };
    };

...
```

## Documentation/devicetree/bindings/ptp/qcom,ptp-tsc.yaml
```yaml
# SPDX-License-Identifier: (GPL-2.0 OR BSD-2-Clause)
%YAML 1.2
---
$id: http://devicetree.org/schemas/ptp/qcom,ptp-tsc.yaml#
$schema: http://devicetree.org/meta-schemas/core.yaml#

title: Qualcomm Technologies, Inc. Timestamp Counter(TSC) based PTP clock

maintainers:
  - Taniya Das <quic_tdas@quicinc.com>
  - Sachin Gupta <sachgupt@qti.qualcomm.com>

description:
  TSC module is a timestamp generator, which runs a 64 bit counter for
  system timekeeping.

properties:
  compatible:
    enum:
      - "qcom,tsc"
      - "qcom,tsc-v1"

  reg:
    maxItems: 4
    items:
     - description: TSC reg
     - description: TSC Timer reg
     - description: TSC ETU reg
     - description: TSC Timestamp Mux control reg

  reg-names:
    items:
      - const: tsc
      - const: timer
      - const: etu
      - const: tsc_src_sel

  clocks:
    items:
      - description: TSC AHB clock
      - description: TSC cntr clock
      - description: TSC ETU clock

  clock-names:
    items:
      - const: cfg_ahb
      - const: cntr
      - const: etu

  interrupts:
    maxItems: 2

  interrupt-names:
    items:
      - const: tscss_fusa_irq
      - const: etu_summary_irq

  qcom,tsc-nsec-update:
     description:
       Indicates the TSC counters have values in nanoseconds, rather than
       in secs and nanoseconds.
     type: boolean

  qcom,tsc-frame-pulse-gen:
     description:
       Indicates the TSC supports frame pulse generation which can be used
       for sensors synchronization.
     type: boolean

  qcom,tsc-safety:
     description:
       Indicates that this TSC instance falls has functional-safety (FuSa)
       use cases and requires additional safety handling.
     type: boolean

  qcom,tsc-pipeline-stages:
    description:
      Specifies the number of pipeline stages for this TSC instance.
      If not specified, the default is 24 stages.
    type: integer

patternProperties:
  "^slice[0-9]+$":
    type: object
    description: ETU slice configuration
    properties:
      qcom,etu-event-sel:
        $ref: /schemas/types.yaml#/definitions/uint32
      qcom,etu-slice:
        $ref: /schemas/types.yaml#/definitions/uint32
      qcom,etu-event-name:
        $ref: /schemas/types.yaml#/definitions/string
    required:
      - qcom,etu-event-sel
      - qcom,etu-slice
      - qcom,etu-event-name
    additionalProperties: false

required:
  - compatible
  - reg
  - reg-names
  - clocks
  - clock-names

additionalProperties: false

examples:
  - |
    tsc: tsc@1c80000 {
      compatible = "qcom,tsc";
      reg = <0x0 0x01c80000 0x0 0x2000>,
            <0x0 0x01c87000 0x0 0x1000>,
            <0x0 0x01ca0000 0x0 0x20000>,
            <0x0 0x01f9e100 0x0 0x4>;
      reg-names = "tsc", "timer", "etu", "tsc_src_sel";
      clocks = <&tscss_ahb_clock>,
	       <&tscss_cntr_clock>,
	       <&tscss_cntr_clock>;
      clock-names = "cfg_ahb",
		    "cntr",
                    "etu";
      qcom,tsc-nsec-update;

      slice@1 {
         qcom,etu-event-sel = <1>;
         qcom,etu-slice = <1>;
         qcom,etu-event-name = "timer0";
      };

      slice@2{
         qcom,etu-event-sel = <2>;
         qcom,etu-slice = <2>;
         qcom,etu-event-name = "timer1";
      };

      slice@3 {
         qcom,etu-event-sel = <3>;
         qcom,etu-slice = <3>;
         qcom,etu-event-name = "timer2";
      };
    };
```

## drivers/nvmem/layouts/Kconfig
```kconfig
# SPDX-License-Identifier: GPL-2.0

menu "Layout Types"

config NVMEM_LAYOUT_SL28_VPD
	tristate "Kontron sl28 VPD layout support"
	select CRC8
	help
	  Say Y here if you want to support the VPD layout of the Kontron
	  SMARC-sAL28 boards.

	  If unsure, say N.

config NVMEM_LAYOUT_ONIE_TLV
	tristate "ONIE tlv support"
	select CRC32
	help
	  Say Y here if you want to support the Open Compute Project ONIE
	  Type-Length-Value standard table.

	  If unsure, say N.

config NVMEM_LAYOUT_QCOM_ETH_MAC
	tristate "Qualcomm Ethernet MAC address layout"
	depends on OF
	help
	  Handles the non-contiguous eFuse storage of eth MAC byte[5]
	  on Qualcomm SoC. Provides transparent post-processing for
	  the ethx-mac nvmem cell.

	  Say Y if you use the SA8797P SoC with Ethernet.

endmenu
```
